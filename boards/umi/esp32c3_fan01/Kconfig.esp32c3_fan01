## boards/umi/esp32c3_fan01/Kconfig.esp32c3_fan01
```kconfig
# Copyright 2024 umi
# SPDX-License-Identifier: Apache-2.0

config BOARD_ESP32C3_FAN01
	select SOC_ESP32C3
```

## boards/umi/esp32c3_fan01/board.yml
```yaml
board:
  name: esp32c3_fan01
  full_name: ESP32C3 FAN01
  vendor: umi
  socs:
  - name: esp32c3
```

## modules/husb238/dts/bindings/hynetek,husb238.yaml
```yaml
description: Hynetek HUSB238 USB PD Sink Controller

compatible: "hynetek,husb238"

include: [i2c-device.yaml]
```

## modules/husb238/zephyr/Kconfig
```kconfig
# SPDX-License-Identifier: Apache-2.0

menu "HUSB238 PD sink driver configuration"

config HUSB238_DRIVER
	bool "Hynetek HUSB238 USB PD sink controller support"
	default y
	depends on DT_HAS_HYNETEK_HUSB238_ENABLED
	select I2C
	help
	  Enable support for the Hynetek HUSB238 I2C USB Power Delivery
	  sink controller.

if HUSB238_DRIVER

config HUSB238_INIT_PRIORITY
	int "Init priority"
	default 80
	help
	  Device driver initialization priority (must be after I2C init).

endif # HUSB238_DRIVER

endmenu
```
